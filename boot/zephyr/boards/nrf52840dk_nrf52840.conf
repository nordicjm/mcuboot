## boot/zephyr/boards/nrf52840dk_nrf52840.conf
```kconfig
#
# Copyright (c) 2023 Nordic Semiconductor ASA
#
# SPDX-License-Identifier: Apache-2.0
#
CONFIG_RETAINED_MEM=y
CONFIG_RETAINED_MEM_NRF_GPREGRET=n
CONFIG_RETAINED_MEM_ZEPHYR_RAM=y
CONFIG_RETENTION=y
CONFIG_BOOT_SHARE_BACKEND_RETENTION=y
CONFIG_BOOT_SHARE_DATA=y
CONFIG_BOOT_SHARE_DATA_BOOTINFO=y
# Ensure that the qspi driver is disabled by default
CONFIG_NORDIC_QSPI_NOR=n
```
